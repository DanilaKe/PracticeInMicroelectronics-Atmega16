.INCLUDE "m16def.inc" 
.LIST 
.CSEG 
.ORG 0x0000 
.equ DELAY = 0xFF 
LDI R16,LOW(RAMEND) 
OUT SPL,R16 
LDI R16,HIGH(RAMEND) 
OUT SPH,R16 
LDI R16,0b11111111 
;OUT DDRA,R16 
OUT DDRB,R16 
OUT DDRC,R16 
OUT DDRD,R16 
RESET: 
CLR R19 
LDI R16,0b01111010 ;
OUT DDRA,R16 
IN R19,PINA ; я считал, что происходит на порте кнопки 
SBRC R19, 0 ; если там единица, то он не пропускает следующую команду. 
RCALL MAIN 
JMP RESET 
MAIN: 
LDI R16,0b11111111 
OUT DDRA,R16 
LDI R16,0b11001011 
OUT PORTA,R16 
LDI R16,0b01011110 
OUT PORTB,R16 
LDI R16,0b01101000 
OUT PORTC,R16 
LDI R16,0b01000000 
OUT PORTD,R16 
RCALL WAIT 
CLR R18 
OUT PORTA,R18 
OUT PORTB,R18 
OUT PORTC,R18 
OUT PORTD,R18 
RCALL WAIT 
RJMP RESET 
WAIT: 
LDI R17,0x12 ;18 
NUM1: 
LDI R18,0x45 ;69 
NUM2: 
LDI R19,0x12 ;18 
NUM3: 
DEC R19 
BRNE NUM3 
DEC R18 
BRNE NUM2 
DEC R17 
BRNE NUM1 
RET