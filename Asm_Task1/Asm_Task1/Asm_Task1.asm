

.INCLUDE "m16def.inc"
.LIST

.CSEG
.ORG 0X0000
.equ DELAY = 0xFF

LDI R16,Low(RAMEND)
OUT SPL,R16
LDI R16,High(RAMEND)
OUT SPH,R16

LDI R16,0b11111111
OUT DDRD,R16
OUT DDRC,R16
OUT DDRB,R16
OUT DDRA,R16

MAIN:
    SBI PORTD,0
    SBI PORTD,1
    SBI PORTD,2
    SBI PORTD,3
    SBI PORTD,4
    SBI PORTD,5
    SBI PORTD,6
    SBI PORTD,7
    RCALL WAIT
    CBI PORTD,0
    CBI PORTD,1
    CBI PORTD,2
    CBI PORTD,3
    CBI PORTD,4
    CBI PORTD,5
    CBI PORTD,6
    CBI PORTD,7
    RCALL WAIT
    SBI PORTD,0
    RCALL WAIT
    SBI PORTC,0
    RCALL WAIT
    SBI PORTB,0
    RCALL WAIT
    SBI PORTA,0
    RCALL WAIT
    CBI PORTA,0
    RCALL WAIT
    CBI PORTB,0
    RCALL WAIT
    CBI PORTC,0
    RCALL WAIT
    CBI PORTD,0
    RCALL WAIT
    SBI PORTA,4
    SBI PORTB,5
    SBI PORTB,3
    SBI PORTC,5
    SBI PORTC,3
    SBI PORTD,4
    RCALL WAIT
    RCALL WAIT
    CBI PORTA,4
    CBI PORTB,5
    CBI PORTB,3
    CBI PORTC,5
    CBI PORTC,3
    CBI PORTD,4
    RJMP MAIN
WAIT:
    LDI R17,DELAY
NUM1:
    LDI R18,0x12
NUM2:
    LDI R19,0x45
NUM3:
    DEC R19
    BRNE NUM3
    DEC R18
    BRNE NUM2
    DEC R17
    BRNE NUM1
RET
